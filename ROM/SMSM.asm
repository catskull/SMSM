; SEGA Master System Music Interface - Z80 code
; Compile with WLA-DX

; By Sebastian Tomczak
; Portions of the code are from Maxim's HelloWorld program, which can be found here: http://www.smspower.org/maxim/uploads/HowToProgram/helloworld.zip


;==============================================================
; WLA-DX banking setup
;==============================================================
.memorymap
defaultslot 0
slotsize $8000
slot 0 $0000
.endme

.rombankmap
bankstotal 1
banksize $8000
banks 1
.endro

;==============================================================
; SDSC tag and SMS rom header
;==============================================================
.sdsctag 1.11,"SMSM" "SMS MIDI Interface","catskull"

.bank 0 slot 0

.org $0000
;==============================================================
; Boot section
;==============================================================
    di              ; disable interrupts
    im 1            ; Interrupt mode 1
    jp Main         ; jump to main program

.org $0066
;==============================================================
; Pause button handler
;==============================================================
    ; Do nothing
    retn

;==============================================================
; Main program
;==============================================================

; set registers to zero, set direction of the TH pin to input
Main:
     ld sp, $dff0 ; set up the stack pointer

     ;==============================================================
     ; Set up VDP registers
     ;==============================================================
     ld hl,VdpData
     ld b,VdpDataEnd-VdpData
     ld c,$bf
     otir

     ;==============================================================
     ; Clear VRAM
     ;==============================================================
     ; 1. Set VRAM write address to 0 by outputting $4000 ORed with $0000
     ld a,$00
     out ($bf),a
     ld a,$40
     out ($bf),a
     ; 2. Output 16KB of zeroes
     ld bc, $4000    ; Counter for 16KB of VRAM
     ClearVRAMLoop:
         ld a,$00    ; Value to write
         out ($be),a ; Output to VRAM address, which is auto-incremented after each write
         dec bc
         ld a,b
         or c
         jp nz,ClearVRAMLoop


     ;==============================================================
     ; Load palette
     ;==============================================================
     ; 1. Set VRAM write address to CRAM (palette) address 0 (for palette index 0)
     ; by outputting $c000 ORed with $0000
     ld a,$00
     out ($bf),a
     ld a,$c0
     out ($bf),a
     ; 2. Output colour data
     ld hl,PaletteData
     ld b,(PaletteDataEnd-PaletteData)
     ld c,$be
     otir

     ;==============================================================
     ; Load tiles (font)
     ;==============================================================
     ; 1. Set VRAM write address to tile index 0
     ; by outputting $4000 ORed with $0000
     ld a,$00
     out ($bf),a
     ld a,$40
     out ($bf),a
     ; 2. Output tile data
     ld hl,FontData              ; Location of tile data
     ld bc,FontDataEnd-FontData  ; Counter for number of bytes to write
     WriteTilesLoop:
         ; Output data byte then three zeroes, because our tile data is 1 bit
         ; and must be increased to 4 bit
         ld a,(hl)        ; Get data byte
         out ($be),a
         inc hl           ; Add one to hl so it points to the next data byte
         dec bc
         ld a,b
         or c
         jp nz,WriteTilesLoop

     ;==============================================================
     ; Write text to name table
     ;==============================================================
     ; 1. Set VRAM write address to name table index 0
     ; by outputting $4000 ORed with $3800+0
     ld a,$00
     out ($bf),a
     ld a,$38|$40
     out ($bf),a
     ; 2. Output tilemap data
     ld hl,Message
     ld bc,MessageEnd-Message  ; Counter for number of bytes to write
     WriteTextLoop:
         ld a,(hl)    ; Get data byte
         out ($be),a
         inc hl       ; Point to next letter
         dec bc
         ld a,b
         or c
         jp nz,WriteTextLoop

     ; Turn screen on
     ld a,%11000000
 ;          |||| |`- Zoomed sprites -> 16x16 pixels
 ;          |||| `-- Doubled sprites -> 2 tiles per sprite, 8x16
 ;          |||`---- 30 row/240 line mode
 ;          ||`----- 28 row/224 line mode
 ;          |`------ VBlank interrupts
 ;          `------- Enable display
     out ($bf),a
     ld a,$81
     out ($bf),a


     ld a,0 ; set register A to 0
     ld b,0 ; set register B to 0

; wait for WRITE pin to be active
Loop:
     in a,($dc) ; load one portion of the control data into register A
     bit 6,a ; check bit6 (write pin)
     jp nz, CheckState ; if the pin is high, there is data present
     jp Loop ; if the pin is not high, there is no data present and we can repeat the check

; check whether nibble is high or low
CheckState:
     bit 7,a	; check bit 7 - if it is high, then the nibble is a high nibble
     jp nz, HighNibble ; jump to the high nibble loading function

; if the nibble is low, load data into register B next write loop
LowNibble:
     in a,($dd) ; load the other portion of the control data into register A - this is the low nibble data
     and $0f ; we are only interested in the lower nibble
     ld b,a ; load register A into register B so we can store the low nibble for later
     jp Loop

; if the nibble is high, assume that a low nibble has already been written
; if TH pin is high, the data present is intended for the FM chip (YM2413)
; if TH pin is low, the data present is intended for the PSG chip (SN76489)

HighNibble:
     in a,($dd) ; load the other portion of the control data into register A - this is the high nibble data
     bit 7,a ; check the TH pin - this signifies whether a byte is eventually for the FM or for the PSG
     jp  nz, doFM ; if the TH pin is high, the data is for the FM chip

     sla       a ; shift the nibble left by one bit
     sla       a ; shift the nibble left by one bit
     sla       a ; shift the nibble left by one bit
     sla       a ; shift the nibble left by one bit
     or        b ; combine with the low nibble stored earlier in register B
          out ($7f),a ; send the data to the PSG
          jp Loop     ; jump to loop, wait for the next write cycle to begin

doFM:
     sla       a ; shift the nibble left by one bit
     sla       a ; shift the nibble left by one bit
     sla       a ; shift the nibble left by one bit
     sla       a ; shift the nibble left by one bit
     or        b ; combine with the low nibble stored earlier in register B

; At this point...
; bit 7 indicates address (high) or data (low)
; bit 6 indicates data nibble (high) or (low)
; bit 5 potentially contains part of the address if byte is an address byte
; bit 4 potentially contains part of the address if byte is an address byte
; bit 3, 2, 1 and 0 are always data bits of either the address or data byte type

     bit 7,a		; check bit 7 - if it is high, then the data present is an address
     jp  nz, ADDRESS	; jump to address loading function if the bit is high
     jp  DATA		; jump to the data loading function if the bit is low

ADDRESS:
     and     $3f      ; since there are only 58 register, we do not need the upper 2 bits of the byte
     out     ($f0),a  ; write and latch the address to the FM chip
     jp  Loop         ; jump to loop, wait for the next write cycle to begin

DATA:
     bit 6,a		; check bit 6 - if it is high, then the nibble is a high data nibble
     jp  nz, DATA_HIGH  ; jump to the high data nibble function

DATA_LOW:
     and $0f	; we are only interested in the lower nibble
     ld  d,a	; load the lower nibble into register D
     jp  Loop	; jump to loop, wait for the next write cycle to begin

; if the nibble is high, we assume that the lower nibble has already been written to the Z80

DATA_HIGH:
     sla       a ; shift the nibble left by one bit
     sla       a ; shift the nibble left by one bit
     sla       a ; shift the nibble left by one bit
     sla       a ; shift the nibble left by one bit
     or        d ; combine with the low nibble stored earlier in register D
     out ($f1),  a	; write the data to the previously latched FM address (stored in the FM chip)
     jp      Loop	; jump to loop, wait for the next write cycle to begin

 ;==============================================================
 ; Data
 ;==============================================================

 Message:
 ;.dw $28,$45,$4c,$4c,$4f,$00,$37,$4f,$52,$4c,$44,$01
 .dw $33,$59,$53,$54,$45,$4d,$00,$52,$45,$41,$44,$59,$01
 MessageEnd:

 PaletteData:
 .db $00,$3f
 PaletteDataEnd:

 ; VDP initialisation data
 VdpData:
 .db $04,$80,$00,$81,$ff,$82,$ff,$85,$ff,$86,$ff,$87,$00,$88,$00,$89,$ff,$8a
 VdpDataEnd:

 FontData:
 .db $00,$00,$00,$00,$00,$00,$00,$00,$00,$00,$00,$00,$00,$00,$00,$00
 .db $00,$00,$00,$00,$00,$00,$00,$00,$00,$00,$00,$00,$00,$00,$00,$00
 .db $18,$00,$00,$00,$18,$00,$00,$00,$18,$00,$00,$00,$18,$00,$00,$00
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 .db $00,$00,$00,$00,$00,$00,$00,$00,$00,$00,$00,$00,$00,$00,$00,$00
 FontDataEnd:
